## prj.conf
```kconfig
#
# Copyright (c) 2018 Nordic Semiconductor
#
# SPDX-License-Identifier: LicenseRef-Nordic-5-Clause
#

# Logger module
CONFIG_LOG=y

# Button and LED library
CONFIG_DK_LIBRARY=y
# Bluetooth LE
CONFIG_BT=y
CONFIG_BT_PERIPHERAL=y
CONFIG_BT_DEVICE_NAME="MYLBS"

# Increase stack size for the main thread and System Workqueue
CONFIG_SYSTEM_WORKQUEUE_STACK_SIZE=2048
CONFIG_MAIN_STACK_SIZE=2048

CONFIG_ADC=y
CONFIG_GPIO=y
CONFIG_CAF=y
#CONFIG_CAF_BUTTONS=y
#CONFIG_CAF_BUTTONS_DEBOUNCE_INTERVAL=250
```

## src/main.c
```c
/*
 * Copyright (c) 2020 Libre Solar Technologies GmbH
 *
 * SPDX-License-Identifier: Apache-2.0
 */
#include <zephyr/logging/log.h>
#include <dk_buttons_and_leds.h>
#include <inttypes.h>
#include <stddef.h>
#include <stdint.h>
#include <zephyr/kernel.h>
#include <zephyr/sys/printk.h>
#include <zephyr/sys/util.h>
#include "adc.h"
#include <zephyr/device.h>
#include <zephyr/devicetree.h>
//#include "neuroluokittelija.c"
#include "confusion.h"



#define USER_LED1         	 	DK_LED1
#define USER_LED2          		DK_LED2
#define USER_LED3               DK_LED3
#define USER_LED4               DK_LED4

#define USER_BUTTON_1           DK_BTN1_MSK
#define USER_BUTTON_2           DK_BTN2_MSK
#define USER_BUTTON_3           DK_BTN3_MSK
#define USER_BUTTON_4           DK_BTN4_MSK

#define DEBUG 0  // 0 = changes direction when button 3 is pressed
                 // 1 = fake 100 measurements done to each 6 directions when 3 pressed.
static int direction = -1;	// 0 = x direction high
							// 1 = x directon low	
							// 2 = y direction high
							// 3 = y direction low
							// 4 = z direction high
							// 5 = z direction low
int dir = -1, prev_dir = -1;
bool btn_4_state = false;
                				 

LOG_MODULE_REGISTER(MAIN, LOG_LEVEL_INF);

static void button_changed(uint32_t button_state, uint32_t has_changed)
{
	//printk("button_state = %d\n",button_state);
	//printk("has_changed = %d\n",has_changed);
	if ((has_changed & USER_BUTTON_1) && (button_state & USER_BUTTON_1)) 
	{
		printk("\nButton 1 down, printing current Confusion Matrix\n");
		struct Measurement m = readADCValue();
		calculateDistanceToAllCentrePointsAndSelectWinner(m.x,m.y,m.z);
		printConfusionMatrix();
		btn_4_state = false;
	}

	if ((has_changed & USER_BUTTON_2) && (button_state & USER_BUTTON_2)) 
	{
		printk("\nButton 2 down, resetting confusion matrix\n");
		
		resetConfusionMatrix();
		printConfusionMatrix();
		btn_4_state = false;
	}		
	
	if ((has_changed & USER_BUTTON_3) && (button_state & USER_BUTTON_3)) 
	{
		printk("\nButton 3 down, making fake 100 meas or one real meas depending on DEBUG state\n");
		btn_4_state = false;
		#if DEBUG
		direction = 0;
		makeHundredFakeClassifications();
		printConfusionMatrix();
		#else
        direction = (direction +1)%6;
		switch (direction)
		{
		case 0:
			printk("Direction is now set x = low\n");
			break;
		case 1:
			printk("Direction is now set y = low\n");
			break;
		case 2:
			printk("Direction is now set x = high\n");
			break;
		case 3:
			printk("Direction is now set y = high\n");
			break;
		case 4:
			printk("Direction is now set z = high\n");
			break;
		case 5:
			printk("Direction is now set z = low\n");
			break;
		
		default:
		    printk("Wrong direction set!!!\n");
			break;
		}

		//struct Measurement m = readADCValue();
		//printk("x = %d,  y = %d,  z = %d\n",m.x,m.y,m.z);
		#endif
	}		

	if ((has_changed & USER_BUTTON_4) && (button_state & USER_BUTTON_4)) 
	{
		#if DEBUG
		printk("button 4 down, one meas and classification with current direction =%d\n",direction);
		btn_4_state = true;
		#else
		struct Measurement m = readADCValue();
		double data[3] = {m.x,m.y,m.z};
		int data_size = sizeof(data) / sizeof(data[0]);
		int suunta = oma_aktivointi(data, data_size);
		printk("\nButton 4 down, one meas and classification with neuralnetwork = %d\n",suunta);
    	printk("x = %d,  y = %d,  z = %d\n\n",m.x,m.y,m.z);
		printConfusionMatrix();
		//makeOneClassificationAndUpdateConfusionMatrix(direction);
		//printConfusionMatrix();
		#endif
	}		
}


void main(void)
{
	int err;
	err = dk_leds_init();
	if (err) {
		LOG_ERR("LEDs init failed (err %d)\n", err);
		return;
	}

	err = dk_buttons_init(button_changed);
	if (err) {
		printk("Cannot init buttons (err: %d)\n", err);
		return;
	}
	
	
	if(initializeADC() != 0)
	{
	printk("ADC initialization failed!");
	return;
	}

	while (1) 
	{
		struct Measurement m = readADCValue();
		//printk("x = %d,  y = %d,  z = %d\n",m.x,m.y,m.z);
		 if (btn_4_state == true){
			dir = makeOneClassificationAndUpdateConfusionMatrix(m.x,m.y,m.z);
			if(dir != prev_dir){
				prev_dir = dir;
				printk("Suunta = %d\n",dir);
			}
		} 
		
		k_sleep(K_MSEC(500));
		
		dk_set_led_on(USER_LED1);
		dk_set_led_on(USER_LED2);
		dk_set_led_on(USER_LED3);
		dk_set_led_on(USER_LED4);
		 
		k_sleep(K_MSEC(500));
		
		dk_set_led_off(USER_LED1);
		dk_set_led_off(USER_LED2);
		dk_set_led_off(USER_LED3);
		dk_set_led_off(USER_LED4);
		 
	}
}
```

## src/confusion.c
```c
#include <zephyr/kernel.h>
#include <math.h>
#include "adc.h"
#include "keskipisteet.h"
#include <time.h>
#include <stdlib.h>
#include "neuroverkonKertoimet.h"
#include "confusion.h"

/* 
  K-means algorithm should provide 6 center points with
  3 values x,y,z. Let's test measurement system with known
  center points. I.e. x,y,z are supposed to have only values
  1 = down and 2 = up
  
  CP matrix is thus the 6 center points got from K-means algoritm
  teaching process. This should actually come from include file like
  #include "KmeansCenterPoints.h"
  
  And measurements matrix is just fake matrix for testing purpose
  actual measurements are taken from ADC when accelerator is connected.
*/ 

int CP[6][3]={
   {1980,1668,1695},
   {1321,1688,1710},
   {1668,2001,1695},
   {1649,1333,1646},
   {1653,1662,2025},
   {1648,1694,1376},
};

int measurements[6][3]={
	               {1,0,0},
						{2,0,0},
						{0,1,0},
						{0,2,0},
						{0,0,1},
						{0,0,2}
};

int CM[6][6] = {0};

void printConfusionMatrix(void)
{
	printk("Confusion matrix = \n");
	printk("   cp1 cp2 cp3 cp4 cp5 cp6\n");
	for(int i = 0;i<6;i++)
	{
		printk("cp%d %d   %d   %d   %d   %d   %d\n",i+1,CM[i][0],CM[i][1],CM[i][2],CM[i][3],CM[i][4],CM[i][5]);
	}
}

void makeHundredFakeClassifications(void)
{
   /*******************************************
   Jos ja toivottavasti kun teet toteutuksen paloissa eli varmistat ensin,
   että etäisyyden laskenta 6 keskipisteeseen toimii ja osaat valita 6 etäisyydestä
   voittajaksi sen lyhyimmän etäisyyden, niin silloin voit käyttää tätä aliohjelmaa
   varmistaaksesi, että etäisuuden laskenta ja luokittelu toimii varmasti tunnetulla
   itse keksimälläsi sensoridatalla ja itse keksimilläsi keskipisteillä.
   *******************************************/
   int min = 1320, max = 2000;
   for (int i=0; i<100; i++){
      int rd_x = rand() % (max - min + 1) + min;
      int rd_y = rand() % (max - min + 1) + min;
      int rd_z = rand() % (max - min + 1) + min;
      //printk("\n%d, %d, %d\n",rd_x,rd_y,rd_z);

      calculateDistanceToAllCentrePointsAndSelectWinner(rd_x,rd_y,rd_z);
   }

   //printf("Make your own implementation for this function if you need this\n");
}

int makeOneClassificationAndUpdateConfusionMatrix(int x, int y, int z)
{
   /**************************************
   Tee toteutus tälle ja voit tietysti muuttaa tämän aliohjelman sellaiseksi,
   että se tekee esim 100 CPl mittauksia tai sitten niin, että tätä funktiota
   kutsutaan 100 kertaa yhden mittauksen ja sen luokittelun tekemiseksi.
   **************************************/
   
   int shortestDistance = 0;
   int curDistance = 0;
   int closestCentrePoint[1][3];
   int direction = 0;
   
   for (int i=0; i<6; i++){
      int square_difference_x = (CP[i][0] - x) * (CP[i][0] - x);
      int square_difference_y = (CP[i][1] - y) * (CP[i][1] - y);
      int square_difference_z = (CP[i][2] - z) * (CP[i][2] - z);
      int sum = square_difference_x + square_difference_y + square_difference_z;
      curDistance = sqrt(sum);

      if (i == 0) shortestDistance = curDistance;

      if (curDistance <= shortestDistance) {
         shortestDistance = curDistance;
         closestCentrePoint[0][0] = CP[i][0];
         closestCentrePoint[0][1] = CP[i][1];
         closestCentrePoint[0][2] = CP[i][2];
      }
   }
   for (int i=0; i<6; i++){
      if (closestCentrePoint[0][0] == CP[i][0]){
         direction = i;
      }
   }

   //printk("Make your own implementation for this function if you need this\n");
   return direction;
}

int calculateDistanceToAllCentrePointsAndSelectWinner(int x,int y,int z)
{
   /***************************************
   Tämän aliohjelma ottaa yhden kiihtyvyysanturin mittauksen x,y,z,
   laskee etäisyyden kaikkiin 6 K-means keskipisteisiin ja valitsee
   sen keskipisteen, jonka etäisyys mittaustulokseen on lyhyin.
   ***************************************/
   int shortestDistance = 0;
   int curDistance = 0;
   int closestCentrePoint[1][3];
   
   for (int i=0; i<6; i++){
      int square_difference_x = (CP[i][0] - x) * (CP[i][0] - x);
      int square_difference_y = (CP[i][1] - y) * (CP[i][1] - y);
      int square_difference_z = (CP[i][2] - z) * (CP[i][2] - z);
      int sum = square_difference_x + square_difference_y + square_difference_z;
      curDistance = sqrt(sum);

      if (i == 0) shortestDistance = curDistance;

      if (curDistance <= shortestDistance) {
         shortestDistance = curDistance;
         closestCentrePoint[0][0] = CP[i][0];
         closestCentrePoint[0][1] = CP[i][1];
         closestCentrePoint[0][2] = CP[i][2];
         resetConfusionMatrix();
         CM[i][i] = 1;
         printk("CM = %d\n",CM[i][i]);
      }
     
   }
/*
   for (int i=0; i<6; i++){
      if (closestCentrePoint[0][0] == CP[i][0]){
         CM[i][i] += 1;
      }
   }
   */
   //printf("%d, ",closestCentrePoint[0][0]);
   //printf("%d, ",closestCentrePoint[0][1]);
   //printf("%d\n",closestCentrePoint[0][2]);

   //printf("lahin centerpoint on = %d",closestCentrePoint);
   return 0;
}

void resetConfusionMatrix(void)
{
	for(int i=0;i<6;i++)
	{ 
		for(int j = 0;j<6;j++)
		{
			CM[i][j]=0;
		}
	}
}


float oma_relu(float x){
    float jau = 0;
    if (x > 0) jau = x;
    else if (x <= 0) jau = 0;
    return jau;
}

void oma_softmax(double output_layer[], double tulos[], int num){
    double expo[num];
    double sum_expo = 0.0;

    // Eksponentiaalit ja niiden summa
    //printf("sum_expo:\n");
    for (int i = 0; i < num; i++) {
        expo[i] = exp(output_layer[i]);
        sum_expo += expo[i];
        //printf("%d. %f\n",i+1,sum_expo);
    }

    // Softmax-arvot
    //printf("Softmax:\n");
    for (int i = 0; i < num; i++) {
        tulos[i] = expo[i] / sum_expo;
        //printf("%d. %f\n",i+1,tulos[i]);

    }
}

int oma_aktivointi(double data[], int data_size){
    double summa=0;
    double hidden_layer[16]={0};
    int hl_size = (sizeof(hidden_layer) / sizeof(hidden_layer[0]));
    double output_layer[6]={0};
    int suunta_paatos = 0;

    //Dense 1 ReLu aktivoinnilla
    for (int i=0; i<bh_size; i++){      //16 = b_hidden määrä
        summa = b_hidden[i];
        for (int j=0; j<data_size; j++){ //3 = testidatan pituus
            summa = summa + data[j] *  w_hidden[j][i];
        }
        hidden_layer[i]=oma_relu(summa);
    }
//    printf("hidden layer:\n");
//    for (int i=0; i<bh_size; i++){
//        printf("%d = %f\n",i+1,hidden_layer[i]);
//    }

    //Dense 2 Softmax aktivoinnilla
    for (int i=0; i<bo_size; i++){      //6 = b_output pituus
        summa = b_output[i];
        for (int j=0; j<hl_size; j++){ //16 = hidden_layer pituus
            summa = summa + hidden_layer[j] * w_output[j][i];
        }
        output_layer[i]=summa;
    }

//    printf("output layer:\n");
//    for (int i=0; i<bo_size; i++){
//        printf("%d: %f\n",i+1,output_layer[i]);
//    }

    //Syötetään data Softmaxiin
    int n = sizeof(output_layer) / sizeof(output_layer[0]);
    double tulos[n];
    oma_softmax(output_layer, tulos, n);

//    printf("Softmax-tulokset:\n");
    for (int i = 0; i < n; i++) {
        //printf("%.0f. ", tulos[i]);
        if (tulos[i]>0.9) suunta_paatos = i;
    }
    CM[suunta_paatos][suunta_paatos] = 1;
    //printk("\nLaitteen suunta = %d\n",suunta_paatos);
    return suunta_paatos+1;
}
```

## src/confusion.h
```c
#ifndef CONFUSION_MATRIX_H
#define CONFUSION_MATRIX_H


void printConfusionMatrix(void);
void makeHundredFakeClassifications(void);
int makeOneClassificationAndUpdateConfusionMatrix(int,int,int);
int calculateDistanceToAllCentrePointsAndSelectWinner(int,int,int);
void resetConfusionMatrix(void);
float oma_relu(float);
void oma_softmax(double[], double[], int);
int oma_aktivointi(double[], int);

#endif
```

## src/keskipisteet.h
```c
int KP[6][3]={
{1980,1668,1695},
{1321,1688,1710},
{1668,2001,1695},
{1649,1333,1646},
{1653,1662,2025},
{1648,1694,1376},
};
```

## src/neuroluokittelija.c
```c
#include <math.h>
#include <stdio.h>
#include "neuroverkonKertoimet.h"
#include "confusion.h"
```

## src/neuroverkonKertoimet.h
```c
#ifndef NEUROVERKONKERTOIMET_H
#define NEUROVERKONKERTOIMET_H

// Piilokerroksen painot ja bias-arvot
double w_hidden[3][16] = {{0.33650463819503784, 0.2631567120552063, -0.5495091676712036, 0.09538407623767853, -0.5618215203285217, -0.09685686230659485, -0.3573862314224243, -0.3518255352973938, 0.2723854184150696, 0.3611312210559845, -0.370657354593277, -0.2057446539402008, 0.06862238049507141, -0.1433473825454712, 0.5466098189353943, 0.3858729898929596}, {0.06367571651935577, -0.40520891547203064, 0.29537802934646606, 0.46851077675819397, -0.5254740118980408, 0.009312927722930908, -0.5039993524551392, -0.36544108390808105, 0.11906345933675766, -0.3785210847854614, 0.00942414253950119, -0.4012618064880371, 0.3793499171733856, -0.3687734007835388, -0.5279302597045898, -0.11180784553289413}, {-0.22463829815387726, -0.42427220940589905, -0.35139650106430054, -0.5904707312583923, -0.07493630051612854, -0.36296096444129944, 0.49120885133743286, -0.08066648244857788, 0.012091759592294693, 0.13033036887645721, 0.44765549898147583, 0.27936622500419617, 0.00854898989200592, -0.5426909327507019, 0.11729282885789871, -0.10068655759096146}};
double b_hidden[16] = {-0.09227059781551361, 0.0, 0.0, -0.023218674585223198, 0.0, 0.0, 0.0, 0.0, -0.03748015686869621, -0.04909832775592804, -0.002751101041212678, -0.12671352922916412, -0.09512927383184433, 0.0, -0.05131268501281738, -0.036478444933891296};

// Ulostulokerroksen painot ja bias-arvot
double w_output[16][6] = {{0.06487926095724106, 0.2484201341867447, 0.2885552942752838, 0.23081257939338684, 0.13854970037937164, -0.2782217860221863}, {0.31917428970336914, 0.19577544927597046, 0.4587353467941284, 0.30630189180374146, 0.007078766822814941, 0.24737340211868286}, {-0.01328510046005249, 0.43516844511032104, 0.1665835976600647, 0.3791881203651428, -0.0569995641708374, -0.01765340566635132}, {-0.25990280508995056, -0.4916973412036896, 0.3721146583557129, 0.12034852802753448, 0.03309525176882744, 0.5751702785491943}, {0.09262597560882568, 0.2158275842666626, -0.448143869638443, -0.3352760076522827, -0.1524132490158081, -0.08922702074050903}, {-0.007867932319641113, 0.0652233362197876, 0.3513191342353821, 0.2703127861022949, 0.36417269706726074, 0.47711873054504395}, {0.21132290363311768, -0.008967936038970947, -0.03147774934768677, 0.3756881356239319, -0.101784348487854, -0.2770465314388275}, {0.21375036239624023, -0.47048419713974, -0.06287220120429993, -0.21459677815437317, -0.5153244137763977, -0.46750953793525696}, {0.13560819625854492, -0.30566585063934326, -0.04273167997598648, 0.007008001208305359, 0.24605730175971985, 0.297669380903244}, {-0.08661109209060669, -0.41277429461479187, -0.2273903340101242, -0.08371611684560776, -0.17260079085826874, -0.41441017389297485}, {-0.4136747121810913, 0.45603030920028687, 0.3190423548221588, 0.19803039729595184, 0.37407809495925903, 0.3552629351615906}, {0.542361855506897, 0.15656910836696625, 0.11655270308256149, -0.058817461133003235, -0.31923553347587585, -0.03478214144706726}, {0.03818945959210396, 0.39638277888298035, 0.15227170288562775, -0.17348317801952362, -0.09713608771562576, -0.2692830264568329}, {-0.3124927878379822, -0.34111106395721436, 0.2845492362976074, 0.45201849937438965, 0.03798031806945801, -0.40835505723953247}, {0.5114032030105591, 0.1187424510717392, -0.08408823609352112, 0.36605334281921387, 0.4576537013053894, 0.36980918049812317}, {-0.10654495656490326, -0.34395831823349, -0.18729174137115479, 0.3930146098136902, -0.3240279257297516, 0.6127730011940002}};
double b_output[6] = {0.0012007799232378602, 0.032687634229660034, 0.022058868780732155, -0.008726857602596283, 0.11936261504888535, 0.1035493016242981};

int bh_size = (sizeof(b_hidden) / sizeof(b_hidden[0]));
int bo_size = (sizeof(b_output) / sizeof(b_output[0]));


#endif // NEUROVERKONKERTOIMET_H
```
